## meta-xe21/conf/layer.conf
```bitbake
# We have a conf and classes directory, add to BBPATH
BBPATH .= ":${LAYERDIR}"

# We have recipes-* directories, add to BBFILES
BBFILES += "${LAYERDIR}/recipes-*/*/*.bb \
            ${LAYERDIR}/recipes-*/*/*.bbappend"

BBFILE_COLLECTIONS += "meta-xe21"
BBFILE_PATTERN_meta-xe21 = "^${LAYERDIR}/"
BBFILE_PRIORITY_meta-xe21 = "6"

#LAYERDEPENDS_meta-xe21 = "core"
#LAYERSERIES_COMPAT_meta-xe21 = "scarthgap"
```
